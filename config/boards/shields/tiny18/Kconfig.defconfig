## config/boards/shields/tiny18/Kconfig.defconfig
```kconfig
config ZMK_BLE
	default y

config ZMK_USB
	default y

if SHIELD_TINY18_LEFT

config ZMK_KEYBOARD_NAME
    default "Tiny 18"

config ZMK_SPLIT_ROLE_CENTRAL
    default y

endif

if SHIELD_TINY18_LEFT || SHIELD_TINY18_RIGHT

config ZMK_SPLIT
    default y

endif
```

## config/boards/shields/tiny18/Kconfig.shield
```kconfig
config SHIELD_TINY18_LEFT
	def_bool $(shields_list_contains,tiny18_left)

config SHIELD_TINY18_RIGHT
	def_bool $(shields_list_contains,tiny18_right)
```
